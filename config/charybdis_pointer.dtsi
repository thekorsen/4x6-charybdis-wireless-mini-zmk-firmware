#include <input/processors.dtsi>
#include <behaviors/input_gestures_accel.dtsi>
#include <dt-bindings/zmk/input_transform.h>

/ {
    pointer_accel: pointer_accel {
        compatible = "zmk,input-processor-acceleration";
        status = "okay";
        input-type = <INPUT_EV_REL>;
        codes = <INPUT_REL_X INPUT_REL_Y>;
        track-remainders;

        sensitivity = <600>;      // try 0.6× base speed (raise if needed)
        y-boost = <1000>;         // vertical matches horizontal
        sensor-dpi = <800>;       // PMW3610 default CPI

        min-factor = <500>;
        max-factor = <4000>;
        speed-threshold = <100>;
        speed-max = <4000>;
        acceleration-exponent = <3>;

    };
};

&trackball_listener {
    /* base processor chain on all layers */
    input-processors = <&pointer_accel &zip_xy_scaler 1 1>;

    /* layer-8 scroll override */
    scroller: scroller {
        layers           = <7>;
        input-processors = <
            &zip_xy_scaler 4 4                              // Scales the scroll speed
            &zip_xy_to_scroll_mapper                         // Converts XY movement to scroll events
            &zip_scroll_transform (INPUT_TRANSFORM_Y_INVERT) // Inverts the scroll direction
        >;
    };
};
